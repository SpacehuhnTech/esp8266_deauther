#ifndef data_h
#define data_h

#include "oui.h"

static uint8_t data_macBuffer;
static char data_vendorBuffer;
static String data_vendorStrBuffer = "";

#define bufSize 6000
int bufc = 0; //buffer counter;

char data_websiteBuffer[bufSize];

/*  sendHeader must be called first, 
  then copy every string (or substring, when generating json files) with sendToBuffer
  and if everything is done call sendBuffer.
*/
void sendBuffer() {
  if(bufc > 0) {
    server.sendContent_P(data_websiteBuffer, bufc);
    bufc = 0;
  }
}

void sendToBuffer(String str) {
  size_t len = str.length();
  if(bufc + len > bufSize){
    server.sendContent_P(data_websiteBuffer, bufc);
    bufc = 0;
  }
  memcpy(data_websiteBuffer + bufc, str.c_str(), len);
  bufc += len;
}

void sendHeader(int code, String type, size_t _size) {
  server.setContentLength(_size);
  server.send(code, type, "");
}

bool sendSPIFFSFile(String path, String mime) {
  #ifdef debug
    Serial.print("REQ: ");
    Serial.print(path);
    Serial.print(" (");
    Serial.print(mime);
    Serial.print(")");
  #endif
  
  if(SPIFFS.exists(path)) {
    //Serial.println("File exists");
    File myFile = SPIFFS.open(path, "r");
    server.streamFile(myFile, mime);
    myFile.close();
    #ifdef debug
      Serial.println(" [OK]");
    #endif
    return true;
  } else {
    Serial.println(" [SPIFFS FAIL]");
    return false;
  }
}

bool loadFromFlash(String path) {
  String dataType = "text/plain";
  if(path.endsWith("/")) path += "index.html";

  if(path.endsWith("html")) dataType = "text/html";
  if(path.endsWith("css")) dataType = "text/css;charset=UTF-8";
  if(path.endsWith("js")) dataType = "text/javascript";
  if(path.endsWith("json")) dataType = "text/json";

  return sendSPIFFSFile(path, dataType);

}

String data_getVendor(uint8_t first, uint8_t second, uint8_t third) {
  data_vendorStrBuffer = "";

  for (int i = 0; i < sizeof(data_vendors) / 11; i++) {

    data_macBuffer = pgm_read_byte_near(data_vendors + i * 11 + 0);
    if (data_macBuffer == first) {
      data_macBuffer = pgm_read_byte_near(data_vendors + i * 11 + 1);
      if (data_macBuffer == second) {
        data_macBuffer = pgm_read_byte_near(data_vendors + i * 11 + 2);
        if (data_macBuffer == third) {

          for (int h = 0; h < 8; h++) {
            data_vendorBuffer = (char)pgm_read_byte_near(data_vendors + i * 11 + 3 + h);
            if (data_vendorBuffer != 0x00) data_vendorStrBuffer += data_vendorBuffer;
          }
          return data_vendorStrBuffer;
        }

      }
    }

  }

  return data_vendorStrBuffer;
}
/*
char* data_getStyle() { 
  int _size = sizeof(data_styleCSS);
  for (int i = 0; i < sizeof(data_websiteBuffer); i++) {
    if (i < _size) data_websiteBuffer[i] = pgm_read_byte_near(data_styleCSS + i);
    else data_websiteBuffer[i] = 0x00;
  }
  return data_websiteBuffer;
}*/

//source: https://forum.arduino.cc/index.php?topic=38107.0
void PrintHex8(uint8_t *data, uint8_t length) {
  Serial.print("0x");
  for (int i = 0; i < length; i++) {
    if (data[i] < 0x10) {
      Serial.print("0");
    }
    Serial.print(data[i], HEX);
    Serial.print(" ");
  }
}

//source: http://shelvin.de/eine-integer-zahl-in-das-arduiono-eeprom-schreiben/
void eepromWriteInt(int adr, int val) {
  byte low, high;
  low = val & 0xFF;
  high = (val >> 8) & 0xFF;
  EEPROM.write(adr, low);
  EEPROM.write(adr + 1, high);
  return;
}

int eepromReadInt(int adr) {
  byte low, high;
  low = EEPROM.read(adr);
  high = EEPROM.read(adr + 1);
  return low + ((high << 8) & 0xFF00);
}

void getRandomVendorMac(uint8_t *buf) {
  int _macRandom = random(sizeof(data_vendors) / 11);
  for (int h = 0; h < 3; h++) buf[h] = pgm_read_byte_near(data_vendors + _macRandom * 11 + h);
  for (int h = 0; h < 3; h++) buf[h + 3] = random(255);
}

bool intInArray(int num, int _array[]) {
  for (int i = 0; i < sizeof(_array); i++) {
    if (_array[i] == num) return true;
  }
  return false;
}

File errlog;
void openLog(){ errlog = SPIFFS.open("/log.txt", "a");}
void addLog(String str){if(errlog){ errlog.println(str); Serial.println(str);}}
void closeLog(){ errlog.close(); }

// Created by http://oleddisplay.squix.ch/ Consider a donation
// In case of problems make sure that you are using the font file with the correct version!
const char Roboto_Mono_8[] PROGMEM = {
  0x07, // Width: 7
  0x0A, // Height: 10
  0x20, // First Char: 32
  0xE0, // Numbers of Chars: 224

  // Jump Table:
  0xFF, 0xFF, 0x00, 0x05,  // 32:65535
  0x00, 0x00, 0x05, 0x05,  // 33:0
  0x00, 0x05, 0x05, 0x04,  // 34:5
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  0x05, 0xDB, 0x07, 0x05,  // 255:1499

  // Font Data:
  0x00, 0x00, 0x00, 0x00, 0xF8, // 33
  0x00, 0x00, 0x18, 0x00, 0x18, // 34
  0x40, 0x00, 0xF8, 0x00, 0xD0, 0x00, 0x78, 0x00, 0x10, // 35
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  0x10, 0x00, 0x68, 0x01, 0xC0, 0x00, 0x38 // 255
};




#endif
